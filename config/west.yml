## config/west.yml
```yaml
manifest:
  remotes:
    - name: cormoran
      url-base: https://github.com/cormoran
    - name: caksoylar
      url-base: https://github.com/caksoylar

  projects:
    - name: zmk
      remote: cormoran
      revision: main+dya
      import:
        file: app/west.yml

    - name: zmk-feature-custom-settings
      remote: cormoran
      revision: main

    - name: zmk-feature-fast-keymap
      remote: cormoran
      revision: main

    - name: zmk-behavior-runtime-sensor-rotate
      remote: cormoran
      revision: main

    - name: zmk-feature-runtime-macro
      remote: cormoran
      revision: main

    - name: zmk-feature-runtime-combo
      remote: cormoran
      revision: main

    - name: zmk-feature-input-stream
      remote: cormoran
      revision: main

    - name: zmk-feature-module-physical-layout
      remote: cormoran
      revision: main

    - name: zmk-driver-pmw3610-with-custom-studio-rpc
      remote: cormoran
      revision: main

    - name: zmk-module-runtime-input-processor
      remote: cormoran
      revision: main

    - name: zmk-module-ble-management
      remote: cormoran
      revision: main
      
    - name: zmk-feature-default-layer
      remote: cormoran
      revision: codex/custom-rpc-rewrite
      
    - name: zmk-feature-os-detection
      remote: cormoran
      revision: main

    - name: zmk-rgbled-widget
      remote: caksoylar
      revision: main
#      revision: v0.3-branch

    - name: zephyr
      remote: cormoran
      revision: v4.1.0+zmk-fixes+nrf-half-duplex-uart
      clone-depth: 1
      import:
        name-blocklist:
          - ci-tools
          - hal_altera
          - hal_cypress
          - hal_infineon
          - hal_microchip
          - hal_nxp
          - hal_openisa
          - hal_xtensa
          - hal_st
          - hal_ti
          - loramac-node
          - mcuboot
          - mcumgr
          - net-tools
          - openthread
          - edtt
          - trusted-firmware-m

  self:
    path: config
```
